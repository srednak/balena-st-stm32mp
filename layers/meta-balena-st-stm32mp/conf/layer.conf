## layers/meta-balena-st-stm32mp/conf/layer.conf
```bitbake
# We have a conf and classes directory, add to BBPATH
BBPATH .= ":${LAYERDIR}"

# We have a recipes-* directories, add to BBFILES
BBFILES += "${LAYERDIR}/recipes-*/*/*.bb \
			${LAYERDIR}/recipes-*/*/*.bbappend"

BBFILE_COLLECTIONS += "balena-st-stm32mp"
BBFILE_PATTERN_balena-st-stm32mp := "^${LAYERDIR}/"
BBFILE_PRIORITY_balena-st-stm32mp = "1337"

EULA_FILE_ST_stm32mpcommonmx = "${LAYERDIR}/conf/eula/${MACHINE}"
EULA_FILE_ST_MD5SUM_stm32mpcommonmx = "8b505090fb679839cefbcc784afe8ce9"

# This should only be incremented on significant changes that will
# cause compatibility issues with other layers
LAYERVERSION_balena-st-stm32mp = "1"
LAYERSERIES_COMPAT_balena-st-stm32mp = "dunfell"

LAYERDEPENDS_balena-st-stm32mp = "stm-st-stm32mp"

# OpenSTLinux compatibility version
ST_OSTL_COMPATIBILTY_VERSION_balena-st-stm32mp = "3.0"

# ENABLE_PARTITIONS_IMAGE is used in st-partitions-image.bbclass
# There are partition configuration conflicts with st-partitions-image.
# So disable it entirely then use st-partitions-image in resin-st-image instead.
ENABLE_PARTITIONS_IMAGE = "0"

ENABLE_FLASHLAYOUT_DEFAULT = "0"

ST_BOOTFS = "0"
ST_VENDORFS = "0"
ST_USERFS = "0"
PARTITIONS_CONFIG_remove = "rootfs"

PARTITIONS_CONFIG += "resin-boot"
PARTITIONS_CONFIG += "resin-rootA"
PARTITIONS_CONFIG += "resin-rootB"
PARTITIONS_CONFIG += "resin-state"
PARTITIONS_CONFIG += "resin-data"

PARTITIONS_CONFIG[resin-boot]	= "resin-boot,resin-boot,'','',System"
PARTITIONS_CONFIG[resin-rootA]	= "resin-rootA,resin-rootA,'','',Binary"
PARTITIONS_CONFIG[resin-rootB]	= "resin-rootB,resin-rootB,'','',Binary"
PARTITIONS_CONFIG[resin-state]	= "resin-state,resin-state,'','',Binary"
PARTITIONS_CONFIG[resin-data]	= "resin-data,resin-data,'','',Binary"

FLASHLAYOUT_PARTITION_ID_resin-boot			= "0x21"
FLASHLAYOUT_PARTITION_ID_resin-rootA		= "0x22"
FLASHLAYOUT_PARTITION_ID_resin-rootB		= "0x23"
FLASHLAYOUT_PARTITION_ID_resin-state		= "0x24"
FLASHLAYOUT_PARTITION_ID_resin-data			= "0x25"
FLASHLAYOUT_PARTITION_OFFSET_resin-boot		= "0x00280000"
FLASHLAYOUT_PARTITION_OFFSET_resin-rootA	= "0x02A80000"
FLASHLAYOUT_PARTITION_OFFSET_resin-rootB	= "0x16A80000"
FLASHLAYOUT_PARTITION_OFFSET_resin-state	= "0x2AA80000"
FLASHLAYOUT_PARTITION_OFFSET_resin-data		= "0x2BE80000"
```
